## firmware/module/Kconfig
```kconfig
rsource "drivers/ethernet/Kconfig"
rsource "drivers/spi/Kconfig"
rsource "lib/fw_update/Kconfig"
rsource "lib/http_files/Kconfig"
rsource "lib/register_bus/Kconfig"
rsource "lib/word_memcpy/Kconfig"
rsource "lib/tcp_stream/Kconfig"
```

## firmware/module/boards/efinix/ti60_evm_eth/board.yml
```yaml
board:
  name: ti60_evm_eth
  full_name: Ti60F225 development kit, Efinix TSEMAC design
  vendor: efinix
  socs:
  - name: efinix_sapphire
```

## firmware/module/boards/efinix/ti60_psu/board.yml
```yaml
board:
  name: ti60_psu
  full_name: ti60_ac_psu board, board_test_cpu design
  vendor: efinix
  socs:
  - name: efinix_sapphire
```

## firmware/module/boards/efinix/ti60_psu_eth/board.yml
```yaml
board:
  name: ti60_psu_eth
  full_name: ti60_ac_psu board, tsemac_soc design
  vendor: efinix
  socs:
  - name: efinix_sapphire
```

## firmware/module/drivers/ethernet/Kconfig
```kconfig
config ETH_EFINIX_TSEMAC
	bool "Efinix TSEMAC with scatter-gather DMA"
	default y
	depends on DT_HAS_EFINIX_TSEMAC_ENABLED && NET_L2_ETHERNET
	select MDIO
	select NET_CHECKSUM_OFFLOAD_SUPPORTED
	help
	  Efinix Triple Speed Ethernet MAC fed by the Sapphire scatter-gather DMA,
	  as in Efinix's TSEMAC example designs.

if ETH_EFINIX_TSEMAC

config ETH_EFINIX_TSEMAC_RX_DESCRIPTORS
	int "Receive descriptors"
	default 16

config ETH_EFINIX_TSEMAC_TX_DESCRIPTORS
	int "Transmit descriptors, the most fragments a frame is sent from"
	default 16
	help
	  The DMA reads a frame straight from its network buffers, one
	  descriptor each. A frame in more fragments is copied into one
	  buffer first.

config ETH_EFINIX_TSEMAC_TX_BATCH
	int "Most frames in a batch of eth_efinix_tx_batch()"
	default 64
	help
	  Frames a sender beside the stack (tcp_stream) hands the transmit
	  DMA in one go, two descriptors each.

config ETH_EFINIX_TSEMAC_PROMISCUOUS
	bool "Receive all frames in the MAC"
	default y
	help
	  The MAC's address filter passes no frames at all, not even broadcast.
	  Efinix's Linux driver ends up promiscuous too: it enables it whenever
	  more than one multicast group is joined. Zephyr's Ethernet layer still
	  drops frames that are not for this interface.

endif

config MDIO_EFINIX_TSEMAC
	bool "Efinix TSEMAC MDIO"
	default y
	depends on DT_HAS_EFINIX_TSEMAC_MDIO_ENABLED && MDIO
```

## firmware/module/drivers/spi/Kconfig
```kconfig
config SPI_EFINIX_SAPPHIRE
	bool "Efinix Sapphire SoC SPI master"
	default y
	depends on DT_HAS_EFINIX_SAPPHIRE_SPI_ENABLED && SPI
	help
	  Polled driver for the Sapphire SoC's SPI master, single data line,
	  controller chip selects.
```

## firmware/module/dts/bindings/ethernet/efinix,tsemac-mdio.yaml
```yaml
description: |
  MDIO master of the Efinix Triple Speed Ethernet MAC.
  reg: "mdio" is the MAC's MDIO register window (MAC base + 0x100), "ctrl" the
  example design's reset control registers (MAC base + 0x200). The MAC and PHY
  are taken out of reset when this device initialises.

compatible: "efinix,tsemac-mdio"

include: mdio-controller.yaml

properties:
  reg:
    required: true

  reg-names:
    required: true
```

## firmware/module/dts/bindings/ethernet/efinix,tsemac.yaml
```yaml
description: |
  Efinix Triple Speed Ethernet MAC with the Sapphire scatter-gather DMA.
  reg: "mac" is the MAC APB window, including the example design's control
  registers at offset 0x200; "dma" is the DMA APB window. Interrupt 0 is the
  receive DMA channel, interrupt 1 the transmit channel.

compatible: "efinix,tsemac"

include: ethernet-controller.yaml

properties:
  reg:
    required: true

  reg-names:
    required: true

  interrupts:
    required: true

  phy-register-updates:
    type: array
    description: |
      Triples of PHY register, mask and value: the bits of mask are replaced by value,
      a mask of 0xffff writes the register. Done in order when the interface comes up,
      then autonegotiation is restarted. For the RGMII delays and quirks of the board's
      PHY, which the PHY driver does not set up.

  tx-checksum-offload:
    type: boolean
    description: |
      The design fills in the IPv4 header, TCP, UDP and ICMP checksums of transmitted
      frames (ti60_ac_psu's tx_checksum_inserter between the DMA and the MAC), so the
      network stack leaves them out. The TSEMAC itself computes none.

  rx-clock-reset-on-link-up:
    type: boolean
    description: |
      Pulse the design's PHY reset control bit when the link comes up. On boards whose
      design uses that bit to restart the PLL behind the PHY's RGMII receive clock, which
      stops while the link is down.
```

## firmware/module/dts/bindings/hvhdl,remote-update.yaml
```yaml
description: |
  The Titanium's internal reconfiguration (remote update) on the register bus of
  ti60_ac_psu's tsemac_soc (remote_update/remote_update.vhd): the role of the running
  image, whether the FPGA fell back to the golden image, and the reconfigure command.

compatible: "hvhdl,remote-update"

include: base.yaml

properties:
  reg:
    required: true
```

## firmware/module/dts/bindings/misc/hvhdl,register-bus-uart.yaml
```yaml
description: |
  A register bus of hVHDL_fpga_interconnect reached through a Sapphire SoC UART that is
  wired, inside the FPGA, to the bus's fpga_communications UART. 16 bit addresses,
  32 bit data, the serial protocol of fpga_communication's uart_link:
    read:   0x02 address           -> 6 (bytes to follow), 0x0000, 4 data bytes
    write:  0x04 address data
    stream: 0x05 address count(3)  -> count times 4 data bytes
  All big endian. The UART clock is the SoC's, CONFIG_SYS_CLOCK_HW_CYCLES_PER_SEC.

compatible: "hvhdl,register-bus-uart"

include: base.yaml

properties:
  reg:
    required: true

  current-speed:
    type: int
    required: true
    description: Baud rate of the bus UART, which must divide the SoC clock by 8 exactly.
```

## firmware/module/dts/bindings/misc/hvhdl,scope-capture.yaml
```yaml
description: |
  ti60_ac_psu's oscilloscope capture (source/scope/scope_capture.vhd) in the tsemac_soc
  design. "registers" is the APB window of its register bus: register r at byte offset
  4*r, the scope's from base-address on. "dma" is the DMA channel that writes its deep
  capture stream into memory.

compatible: "hvhdl,scope-capture"

include: base.yaml

properties:
  reg:
    required: true

  reg-names:
    required: true

  base-address:
    type: int
    required: true
    description: Register bus address of the scope's register 0.
```

## firmware/module/dts/bindings/spi/efinix,sapphire-spi.yaml
```yaml
description: |
  SPI master of the Efinix Sapphire SoC (SpinalHDL SpiXdrMaster, Linux
  "spinal-lib,spi-1.0"). Commands and responses go through FIFOs; chip selects
  are driven by the controller, one per ss line.

compatible: "efinix,sapphire-spi"

include: spi-controller.yaml

properties:
  reg:
    required: true

  clock-frequency:
    type: int
    required: true
    description: |
      Clock of the SPI block (the SoC's system or peripheral clock); SCLK is
      clock-frequency / ((divider + 1) * 2).

  cmd-fifo-depth:
    type: int
    default: 256
    description: Command FIFO depth, SYSTEM_SPI_n_IO_PARAMETER_CMD_FIFO_DEPTH in soc.h.

  rsp-fifo-depth:
    type: int
    default: 256
    description: Response FIFO depth, SYSTEM_SPI_n_IO_PARAMETER_RSP_FIFO_DEPTH in soc.h.
```

## firmware/module/lib/fw_update/Kconfig
```kconfig
config FW_UPDATE
	bool "Firmware update over HTTP"
	depends on FLASH_MAP && HTTP_SERVER && REBOOT && XIP
	depends on $(dt_nodelabel_enabled,slot0_partition) && $(dt_nodelabel_enabled,slot1_partition)
	depends on $(dt_nodelabel_enabled,loader_partition)
	select CRC
	help
	  POST a zephyr.bin to an HTTP resource: it is written to the image
	  slot of the second-stage loader (loader/) that is not running, and
	  the board reboots into it. XIP: the running slot is recognised by
	  the image region, which Zephyr does not write then.

if FW_UPDATE

config FW_UPDATE_REBOOT_DELAY_MS
	int "Delay between the response and the reboot"
	default 500

config FW_UPDATE_FPGA
	bool "FPGA update: the application image of the remote_update scheme"
	default y
	depends on DT_HAS_HVHDL_REMOTE_UPDATE_ENABLED
	depends on $(dt_nodelabel_enabled,fpga_application_partition)
	depends on $(dt_nodelabel_enabled,fpga_state_partition)
	help
	  fpga_update.h: images/application_update.bin of ti60_ac_psu's
	  tsemac_soc goes to the FPGA application image and the FPGA reloads
	  from it; at boot the golden image switches to it. No JTAG needed.

config FW_UPDATE_FPGA_CONFIRM_S
	int "Seconds an application image runs before it counts as working"
	default 10
	depends on FW_UPDATE_FPGA
	help
	  Until then a power cycle leaves the board on the golden image.

endif
```

## firmware/module/lib/http_files/Kconfig
```kconfig
config HTTP_FILES
	bool "List, write and delete files over HTTP"
	depends on FILE_SYSTEM && HTTP_SERVER && HTTP_SERVER_RESOURCE_WILDCARD

if HTTP_FILES

config HTTP_FILES_ROOT
	string "Directory of the files"
	default "/web"

endif
```

## firmware/module/lib/register_bus/Kconfig
```kconfig
config REGISTER_BUS
	bool "FPGA register bus over an internal UART"
	default y
	depends on DT_HAS_HVHDL_REGISTER_BUS_UART_ENABLED

if REGISTER_BUS

config REGISTER_BUS_TIMEOUT_US
	int "Time the FPGA has to start answering a read"
	default 10000

config REGISTER_BUS_SHELL
	bool "Shell commands: bus read, write, stream"
	default y
	depends on SHELL

endif
```

## firmware/module/lib/tcp_stream/Kconfig
```kconfig
config TCP_STREAM
	bool "A fast TCP stream beside the network stack"
	depends on ETH_EFINIX_TSEMAC && NET_IPV4
	help
	  One connection at a time on one port, sending segments built from
	  where the data is (tcp_stream.h): the TSEMAC driver's receive hook
	  and transmit batches, checksums from the design.

if TCP_STREAM

config TCP_STREAM_BATCH
	int "Segments per transmit batch"
	default 32
	help
	  At most ETH_EFINIX_TSEMAC_TX_BATCH. A full batch of full segments
	  is about 380 us at 1000 Mb/s.

config TCP_STREAM_RX_SLOTS
	int "Received frames waiting for the stream's thread"
	default 16

config TCP_STREAM_REPLY_SIZE
	int "Bytes the source may send before its segments"
	default 512

config TCP_STREAM_POLL
	bool "Poll the transmit DMA instead of sleeping a tick"
	help
	  For measuring: the thread spins while a batch is sent.

config TCP_STREAM_THREAD_PRIORITY
	int "Priority of the stream's thread"
	default 8

config TCP_STREAM_STACK_SIZE
	int "Stack of the stream's thread"
	default 2048

config TCP_STREAM_WEBSOCKET
	bool "WebSocket server over the stream (ws_stream.h)"
	select BASE64
	select PSA_CRYPTO
	select PSA_WANT_ALG_SHA_1

endif
```

## firmware/module/lib/word_memcpy/Kconfig
```kconfig
config WORD_MEMCPY
	bool "memcpy and memmove that store whole words at any alignment"
	help
	  Replaces the C library's memcpy and memmove with ones that copy words
	  also when source and destination are aligned differently within a
	  word, where picolibc copies bytes. For a CPU whose every store goes to
	  slow memory, a Sapphire SoC with a write-through data cache running
	  from HyperRAM.
```
