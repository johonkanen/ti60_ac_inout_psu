## CMakeLists.txt
```
cmake_minimum_required(VERSION 3.20.0)

# boards and the TSEMAC driver live in the workspace's module
list(APPEND EXTRA_ZEPHYR_MODULES ${CMAKE_CURRENT_SOURCE_DIR}/../../module)

find_package(Zephyr REQUIRED HINTS $ENV{ZEPHYR_BASE})
project(tcp_tx)

target_sources(app PRIVATE src/main.c)
```

## prj.conf
```kconfig
CONFIG_MAIN_STACK_SIZE=4096
CONFIG_HEAP_MEM_POOL_SIZE=131072

CONFIG_NETWORKING=y
CONFIG_NET_L2_ETHERNET=y
CONFIG_NET_IPV4=y
CONFIG_NET_IPV6=n
CONFIG_NET_TCP=y
CONFIG_NET_SOCKETS=y
CONFIG_NET_DHCPV4=y
CONFIG_NET_CONFIG_SETTINGS=y
CONFIG_NET_CONFIG_NEED_IPV4=y
CONFIG_NET_CONFIG_INIT_TIMEOUT=0

# the scope app's network settings, so the two are comparable
CONFIG_NET_PKT_RX_COUNT=32
CONFIG_NET_PKT_TX_COUNT=64
CONFIG_NET_BUF_RX_COUNT=64
CONFIG_NET_BUF_TX_COUNT=128
CONFIG_NET_BUF_DATA_SIZE=1536
CONFIG_NET_TCP_MAX_SEND_WINDOW_SIZE=65535

# no entropy source in the SoC; fine for this, not for TLS
CONFIG_TEST_RANDOM_GENERATOR=y
CONFIG_LOG=y
```

## src/main.c
```c
/*
 * Raw TCP transmit rate: a server on port 5003 that sends a 64 KB buffer over and over
 * to whoever connects, until the client closes. The client counts (tcp_tx_client.py).
 * The same network settings as the scope app, without its capture, copies or pacing.
 */
#include <errno.h>
#include <zephyr/kernel.h>
#include <zephyr/net/socket.h>

#define PORT  5003
#define CHUNK (64 * 1024)

static uint8_t buffer[CHUNK];

int main(void)
{
	struct sockaddr_in address = {
		.sin_family = AF_INET,
		.sin_port = htons(PORT),
	};
	int server = zsock_socket(AF_INET, SOCK_STREAM, IPPROTO_TCP);

	for (int i = 0; i < CHUNK; i++) {
		buffer[i] = (uint8_t)i;
	}
	zsock_bind(server, (struct sockaddr *)&address, sizeof(address));
	zsock_listen(server, 1);
	printk("tcp_tx on %s: port %d\n", CONFIG_BOARD_TARGET, PORT);

	while (true) {
		int client = zsock_accept(server, NULL, NULL);
		uint64_t sent = 0;
		int64_t start = k_uptime_get();

		while (true) {
			ssize_t n = zsock_send(client, buffer, CHUNK, 0);

			if (n <= 0) {
				break;
			}
			sent += n;
		}
		int64_t ms = k_uptime_get() - start;

		printk("sent %llu bytes in %lld ms, %llu kB/s\n", sent, ms,
		       ms ? sent / (uint64_t)ms : 0);
		zsock_close(client);
	}
	return 0;
}
```
