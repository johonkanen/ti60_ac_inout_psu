## CMakeLists.txt
```
cmake_minimum_required(VERSION 3.20.0)

# board ti60_evm_eth and the TSEMAC/MDIO drivers live in the workspace's module
list(APPEND EXTRA_ZEPHYR_MODULES ${CMAKE_CURRENT_SOURCE_DIR}/../../module)

find_package(Zephyr REQUIRED HINTS $ENV{ZEPHYR_BASE})
project(scope)

target_sources(app PRIVATE src/main.c src/scope.c src/panel.c)

# the commit built (git_version.h for main.c's LCD line), looked at on every build
set(GIT_VERSION_DIR ${CMAKE_CURRENT_BINARY_DIR}/git_version)
add_custom_target(git_version
  COMMAND ${CMAKE_COMMAND} -DSOURCE_DIR=${CMAKE_CURRENT_SOURCE_DIR} -DOUT=${GIT_VERSION_DIR}/git_version.h
          -P ${CMAKE_CURRENT_SOURCE_DIR}/git_version.cmake
  BYPRODUCTS ${GIT_VERSION_DIR}/git_version.h)
add_dependencies(app git_version)
target_include_directories(app PRIVATE ${GIT_VERSION_DIR})
# Zephyr's websocket context (scope.c: the clients' own buffers, their TCP sockets closed)
target_include_directories(app PRIVATE ${ZEPHYR_BASE}/subsys/net/lib/websocket)
# the FPGA's scope_capture where the board has it, else the software stand-in
if(CONFIG_SCOPE_CAPTURE_HW)
  target_sources(app PRIVATE src/capture_hw.c)
  target_sources_ifdef(CONFIG_SCOPE_STREAM app PRIVATE src/stream.c)
else()
  target_sources(app PRIVATE src/capture_sim.c)
endif()

# HTTP resources of scope_service
zephyr_linker_sources(SECTIONS sections.ld)

# the web client in web/ is not in the image: upload_web.sh puts it in the board's flash
```

## Kconfig
```
config SCOPE_CAPTURE_HW
	bool "Capture with the FPGA's scope_capture"
	default y
	depends on DT_HAS_HVHDL_SCOPE_CAPTURE_ENABLED
	help
	  The scope_capture block of ti60_ac_psu's tsemac_soc design, its deep
	  capture written into a ring in this RAM by a DMA channel. Without it
	  the captures come from a software model of its test generator.

config SCOPE_RING_RECORDS
	int "Records in the capture ring"
	default 1048576
	depends on SCOPE_CAPTURE_HW
	help
	  A record is a sample of all eight channels, 16 bytes. A power of two. The ring is on
	  the HyperRAM's second die (16 MB), shared with the stream's.

config SCOPE_STREAM
	bool "Stream the FPGA's continuous capture on a WebSocket of its own"
	default y
	depends on SCOPE_CAPTURE_HW
	select TCP_STREAM
	select TCP_STREAM_WEBSOCKET
	help
	  Port 5004 (stream.c): sent from the capture ring by tcp_stream beside
	  the network stack, as fast as the link takes it.

source "Kconfig.zephyr"
```

## prj.conf
```kconfig
CONFIG_MAIN_STACK_SIZE=4096
CONFIG_SYSTEM_WORKQUEUE_STACK_SIZE=4096
CONFIG_HEAP_MEM_POOL_SIZE=131072

CONFIG_NETWORKING=y
CONFIG_NET_L2_ETHERNET=y
CONFIG_NET_IPV4=y
CONFIG_NET_IPV6=n
CONFIG_NET_TCP=y
CONFIG_NET_SOCKETS=y
CONFIG_NET_DHCPV4=y
CONFIG_NET_CONFIG_SETTINGS=y
CONFIG_NET_CONFIG_NEED_IPV4=y
CONFIG_NET_CONFIG_INIT_TIMEOUT=0
# a context per TCP connection: up to 12 HTTP clients, 6 websockets, the stream, the listeners
CONFIG_NET_MAX_CONTEXTS=28
CONFIG_NET_MAX_CONN=28
CONFIG_NET_TCP_TIME_WAIT_DELAY=0
# captures are up to 64 KB, the stack needs room to stream them
CONFIG_NET_PKT_RX_COUNT=32
CONFIG_NET_PKT_TX_COUNT=64
CONFIG_NET_BUF_RX_COUNT=64
CONFIG_NET_BUF_TX_COUNT=128
CONFIG_NET_BUF_DATA_SIZE=1536
# 32 KB: a 64 KB window loses segments on the way out and waits for their retransmits (a 512 KB
# scope capture took 516 ms to send, 320 ms at 32 KB, the same down to 8 KB: the CPU's limit)
CONFIG_NET_TCP_MAX_SEND_WINDOW_SIZE=32768

CONFIG_HTTP_PARSER=y
CONFIG_HTTP_PARSER_URL=y
CONFIG_HTTP_SERVER=y
CONFIG_HTTP_SERVER_WEBSOCKET=y
# a WebSocket context per /ws client (scope.c MAX_CLIENTS): Zephyr's default is one
CONFIG_WEBSOCKET_MAX_CONTEXTS=6
# browsers keep up to 6 connections a page open after loading it, idle (closed by the server
# after its 10 s); 12 slots so that a second browser or tab finds some free
CONFIG_HTTP_SERVER_MAX_CLIENTS=12
CONFIG_HTTP_SERVER_RESOURCE_WILDCARD=y
# the web client from flash: index.html.gz etc. served to browsers that take gzip
CONFIG_HTTP_SERVER_COMPRESSION=y
CONFIG_HTTP_SERVER_STATIC_FS_RESPONSE_SIZE=4096
CONFIG_HTTP_SERVER_STACK_SIZE=8192
# fds: the HTTP clients, two a websocket (its own and its TCP socket's), files, the stream
CONFIG_ZVFS_OPEN_MAX=48
CONFIG_ZVFS_POLL_MAX=24
CONFIG_EVENTFD=y
# the HTTP server's and the telnet shell's: with only one, telnet took it and the HTTP server
# (and with it the firmware update) did not start
CONFIG_ZVFS_EVENTFD_MAX=2

# no entropy source in the SoC; fine for this, not for TLS
CONFIG_TEST_RANDOM_GENERATOR=y
# %f in the JSON messages
CONFIG_PICOLIBC_IO_FLOAT=y

CONFIG_SHELL=y
CONFIG_NET_SHELL=y
# the shell and the log over the network too: telnet 192.168.20.11 (port 23, no login: for
# the lab's own network only)
CONFIG_SHELL_BACKEND_TELNET=y
CONFIG_SHELL_TELNET_INIT_LOG_LEVEL_INF=y
CONFIG_LOG=y
CONFIG_NET_LOG=y
CONFIG_ETHERNET_LOG_LEVEL_INF=y

# firmware update: POST zephyr.bin to /update (fpga/ti60_evm_eth/update.sh)
CONFIG_SPI=y
CONFIG_FLASH=y
CONFIG_FLASH_MAP=y
CONFIG_REBOOT=y
CONFIG_FW_UPDATE=y

# web client files in a littlefs on the storage partition, /files/ to replace them
# (upload_web.sh)
CONFIG_FILE_SYSTEM=y
CONFIG_FILE_SYSTEM_LITTLEFS=y
# littlefs blocks are the flash layout's pages: 4 KB sectors, not the default 64 KB blocks
CONFIG_SPI_NOR_FLASH_LAYOUT_PAGE_SIZE=4096
CONFIG_HTTP_FILES=y
```

## boards/ti60_psu_eth.overlay
```dts
/* the web client lives in a littlefs filesystem on the flash's storage partition */
/ {
	fstab {
		compatible = "zephyr,fstab";

		web_fs: web {
			compatible = "zephyr,fstab,littlefs";
			mount-point = "/web";
			partition = <&storage_partition>;
			automount;
			read-size = <16>;
			prog-size = <256>;
			cache-size = <256>;
			lookahead-size = <64>;
			block-cycles = <512>;
		};
	};
};
```

## src/main.c
```c
/*
 * Oscilloscope web app: serves the scope web client from flash and its /ws WebSocket on
 * port 80, takes firmware updates on /update and web client files on /files/.
 * The address comes from DHCP and is printed on the console.
 */
#include <zephyr/kernel.h>
#include <zephyr/net/http/server.h>
#include <zephyr/net/http/service.h>
#include <zephyr/fs/fs.h>
#include <stdio.h>
#include <string.h>
#include <zephyr/net/net_if.h>
#include <zephyr/net/net_pkt.h>
#include <zephyr/sys/reboot.h>
#include <zephyr/logging/log_ctrl.h>
#include <fw_update.h>
#include <fpga_update.h>
#include <http_files.h>
#include "scope.h"

/*
 * The web client: files of the littlefs on flash, uploaded gzipped by upload_web.sh.
 * Everything the resources below do not take is looked up there.
 */
#define WEB_ROOT "/web"

/*
 * Served by this dynamic resource, not Zephyr's static filesystem one: that one (v4.4.2) sends
 * "\r\n\r\n" after each file, four bytes its Content-Length does not count, so on a kept-alive
 * connection the next response seems to start with them; Firefox then took the next file for
 * one without headers and the pages did not start. Here a file goes out chunked, gzipped as it
 * is stored, its type from its name.
 */
static struct {
	bool open;
	struct fs_file_t file;
	char path[sizeof(WEB_ROOT) + 72];
	uint8_t chunk[4096];
	struct http_header headers[2];
} web;

static const char *content_type_of(const char *name)
{
	static const struct {
		const char *ext, *type;
	} types[] = {
		{".html", "text/html"}, {".js", "text/javascript"}, {".css", "text/css"},
		{".json", "application/json"}, {".svg", "image/svg+xml"}, {".png", "image/png"},
		{".ico", "image/x-icon"}, {".txt", "text/plain"},
	};
	size_t n = strlen(name);

	for (size_t i = 0; i < ARRAY_SIZE(types); i++) {
		size_t e = strlen(types[i].ext);

		if (n >= e && strcmp(name + n - e, types[i].ext) == 0) {
			return types[i].type;
		}
	}
	return "application/octet-stream";
}

static void web_close(void)
{
	if (web.open) {
		fs_close(&web.file);
		web.open = false;
	}
}

static int web_cb(struct http_client_ctx *client, enum http_transaction_status status,
		  const struct http_request_ctx *request_ctx, struct http_response_ctx *response,
		  void *user_data)
{
	ARG_UNUSED(request_ctx);
	ARG_UNUSED(user_data);

	if (status == HTTP_SERVER_TRANSACTION_ABORTED || status == HTTP_SERVER_TRANSACTION_COMPLETE) {
		web_close();
		return 0;
	}
	if (!web.open) {
		/* the request: the URL's path, "/" the index, any "?..." left out */
		char name[64];
		const char *url = (const char *)client->url_buffer;
		size_t len = strcspn(url, "?#");

		if (len <= 1) {
			strcpy(name, "index.html");
		} else if (len - 1 < sizeof(name) && strstr(url, "..") == NULL) {
			memcpy(name, url + 1, len - 1);
			name[len - 1] = '\0';
		} else {
			name[0] = '\0';
		}
		snprintf(web.path, sizeof(web.path), WEB_ROOT "/%s.gz", name);
		fs_file_t_init(&web.file);
		if (name[0] == '\0' || strchr(name, '/') != NULL ||
		    fs_open(&web.file, web.path, FS_O_READ) != 0) {
			static const char missing[] = "not found\n";

			response->status = HTTP_404_NOT_FOUND;
			response->body = (const uint8_t *)missing;
			response->body_len = sizeof(missing) - 1;
			response->final_chunk = true;
			return 0;
		}
		web.open = true;
		web.headers[0] = (struct http_header){"Content-Type", content_type_of(name)};
		web.headers[1] = (struct http_header){"Content-Encoding", "gzip"};
		response->headers = web.headers;
		response->header_count = ARRAY_SIZE(web.headers);
		response->status = HTTP_200_OK;
	}

	ssize_t n = fs_read(&web.file, web.chunk, sizeof(web.chunk));

	if (n < 0) {
		n = 0;
	}
	response->body = web.chunk;
	response->body_len = n;
	if (n < (ssize_t)sizeof(web.chunk)) {
		response->final_chunk = true;
		web_close();
	}
	return 0;
}

static struct http_resource_detail_dynamic web_files = {
	.common = {
		.type = HTTP_RESOURCE_TYPE_DYNAMIC,
		.bitmask_of_supported_http_methods = BIT(HTTP_GET),
	},
	.cb = web_cb,
};

static int ws_setup(int ws_socket, struct http_request_ctx *request_ctx, void *user_data)
{
	ARG_UNUSED(request_ctx);
	ARG_UNUSED(user_data);

	/* a page connected: the network works, see fpga_update.h */
	if (IS_ENABLED(CONFIG_FW_UPDATE_FPGA)) {
		fpga_update_network_works();
	}
	return scope_client_add(ws_socket);
}

static uint8_t ws_buffer[1024];

static struct http_resource_detail_websocket ws = {
	.common = {
		.type = HTTP_RESOURCE_TYPE_WEBSOCKET,
		.bitmask_of_supported_http_methods = BIT(HTTP_GET),
	},
	.cb = ws_setup,
	.data_buffer = ws_buffer,
	.data_buffer_len = sizeof(ws_buffer),
};

static uint16_t http_port = 80;

HTTP_SERVICE_DEFINE(scope_service, NULL, &http_port, CONFIG_HTTP_SERVER_MAX_CLIENTS, 4, NULL,
		    NULL, NULL);
HTTP_RESOURCE_DEFINE(ws_resource, scope_service, "/ws", &ws);
HTTP_RESOURCE_DEFINE(update_resource, scope_service, "/update", &fw_update_resource);
HTTP_RESOURCE_DEFINE(files_resource, scope_service, "/files/*", &http_files_resource);
/* the web client: everything the others do not take. A resource, not the service's fallback:
 * the server releases a dynamic resource whose transfer broke off (a reset connection) only
 * for its resources, a fallback stayed held and answered every later request 409. Its name
 * sorts last, so the other wildcards (the files resource) are matched first. */
HTTP_RESOURCE_DEFINE(zweb_resource, scope_service, "/*", &web_files.common);
/* and the bare address, which the wildcard does not match: the index */
HTTP_RESOURCE_DEFINE(zweb_root_resource, scope_service, "/", &web_files.common);

/*
 * The network's watchdog: no receive packet of the stack free for NET_STUCK_S seconds and the
 * network is dead (every frame dropped, the board unreachable), so the firmware starts again
 * (the FPGA brings a run down without its kicks; the STOP button works throughout). The
 * restarts (and a crash's, below) are counted in memory a reboot keeps, shown on the face panel.
 */
#define NET_STUCK_S 10
#define NET_RESETS_MAGIC 0x4e455452u     /* "NETR" */
static __noinit uint32_t net_resets_magic;
static __noinit uint32_t net_resets;

uint32_t scope_net_resets(void)
{
	return net_resets_magic == NET_RESETS_MAGIC ? net_resets : 0;
}

static void net_watchdog(struct k_work *work)
{
	static int stuck_s;
	struct k_mem_slab *rx, *tx;
	struct net_buf_pool *rx_data, *tx_data;

	net_pkt_get_info(&rx, &tx, &rx_data, &tx_data);
	stuck_s = k_mem_slab_num_free_get(rx) == 0 ? stuck_s + 1 : 0;
	if (stuck_s >= NET_STUCK_S) {
		if (net_resets_magic != NET_RESETS_MAGIC) {
			net_resets_magic = NET_RESETS_MAGIC;
			net_resets = 0;
		}
		net_resets++;
		LOG_PANIC();
		printk("network stuck: no receive packet free for %d s, restart %u\n", NET_STUCK_S,
		       net_resets);
		sys_reboot(SYS_REBOOT_COLD);
	}
	k_work_reschedule(k_work_delayable_from_work(work), K_SECONDS(1));
}

static K_WORK_DELAYABLE_DEFINE(net_watchdog_work, net_watchdog);

/*
 * A crash (its report on the console already) starts the firmware again rather than halting
 * it, which left the board unreachable until a power cycle; counted with the network's
 * restarts on the face panel.
 */
void k_sys_fatal_error_handler(unsigned int reason, const struct arch_esf *esf)
{
	ARG_UNUSED(esf);

	if (net_resets_magic != NET_RESETS_MAGIC) {
		net_resets_magic = NET_RESETS_MAGIC;
		net_resets = 0;
	}
	net_resets++;
	LOG_PANIC();
	printk("fatal error %u: restart %u\n", reason, net_resets);
	sys_reboot(SYS_REBOOT_COLD);
	CODE_UNREACHABLE;
}

int main(void)
{
	struct fs_dirent entry;

	printk("scope on %s, open http://<address>/ in a browser\n", CONFIG_BOARD_TARGET);
	capture_init(); /* source names for the clients, before they can connect */
	{
		struct scope_config c;

		scope_get_config(&c);
		capture_set_adc_masks(c.adc_masks); /* the FPGA starts with all eight */
		capture_set_adc_settle(c.adc_settle_ns);
		capture_set_sdm(c.sdm_log2, c.sdm_phase);
		capture_set_dhb_control(false, c.dhb_kp, c.dhb_ki, c.dhb_limit_high, c.dhb_limit_low);
		capture_set_dhb_protection(c.dhb_overcurrent, c.dhb_overvoltage, c.dhb_overvoltage_readings);
		capture_set_dhb_filter(c.dhb_filter);
		capture_set_gate_power(c.gate_power); /* off after a restart */
	}
	scope_settings_load();
	capture_scaler_init();
	if (fs_stat(WEB_ROOT "/index.html.gz", &entry) != 0) {
		printk("no web client in flash yet: apps/scope/upload_web.sh <address>\n");
	}
	http_server_start();
	panel_start();
	k_work_reschedule(&net_watchdog_work, K_SECONDS(1));
#ifdef CONFIG_SCOPE_STREAM
	/* the stream answers on the board's address, which a DHCP lease may bring late */
	for (int s = 0; s < 30; s++) {
		if (net_if_ipv4_get_global_addr(net_if_get_default(), NET_ADDR_PREFERRED) != NULL) {
			scope_stream_init();
			break;
		}
		k_sleep(K_SECONDS(1));
	}
#endif
	return 0;
}
```

## src/capture_sim.c
```c
/*
 * Software stand-in for ti60_ac_psu's scope_capture and test_signal_generator.vhd: the same
 * sixteen sources computed the same way, sampled every divider+1 clocks of a 125 MHz clock.
 *
 * The generator runs on between captures as if it never stopped: before each capture it is
 * advanced by the samples that would have passed since the last one. A capture is taken from
 * twice the record length of fresh samples, placed so that the first trigger crossing that
 * leaves room for the pre-trigger samples lands at sample pre.
 */
#include <errno.h>
#include <math.h>
#include <string.h>
#include <zephyr/kernel.h>
#include "scope.h"

const char *scope_source_names[SCOPE_SOURCES] = {
	"sine", "cosine", "triangle", "square", "sawtooth", "noise", "sine + noise", "counter",
	"probe 0: clock 15:0", "probe 1: clock 31:16", "probe 2", "probe 3",
	"probe 4", "probe 5", "probe 6", "probe 7",
};

#define SINE_POINTS 1024
#define PI          3.14159265358979323846

static int16_t sine_table[SINE_POINTS];

/* generator state, kept between captures */
static uint32_t phase;
static uint32_t lfsr = 0xACE11234;
static uint16_t counter;
static uint32_t clock_count;
static int64_t last_uptime_us;

static int16_t window[2 * SCOPE_WS_MAX_LENGTH][SCOPE_CHANNELS];   /* longer: the hardware's */

static void make_sine_table(void)
{
	/* round(32000*sin(2*pi*i/1024)), as sine_table_pkg.vhd */
	for (int i = 0; i < SINE_POINTS; i++) {
		sine_table[i] = (int16_t)lround(32000.0 * sin(2.0 * PI * i / SINE_POINTS));
	}
}

static int16_t source_value(uint8_t source)
{
	uint32_t index = phase >> 22;
	int16_t noise = (int16_t)(lfsr & 0xffff);
	int32_t triangle;

	switch (source) {
	case 0:
		return sine_table[index];
	case 1:
		return sine_table[(index + 256) % SINE_POINTS];
	case 2:
		triangle = (phase >> 15) & 0xffff;
		return (int16_t)((phase & BIT(31)) ? 32767 - triangle : triangle - 32768);
	case 3:
		return (phase & BIT(31)) ? -24000 : 24000;
	case 4:
		return (int16_t)((phase >> 16) ^ 0x8000);
	case 5:
		return noise;
	case 6:
		return (int16_t)(sine_table[index] / 2 + (noise >> 4));
	case 7:
		return (int16_t)counter;
	case 8:
		return (int16_t)(clock_count & 0xffff);
	case 9:
		return (int16_t)(clock_count >> 16);
	default:
		return 0;
	}
}

static void generator_step(uint32_t increment, uint32_t clocks)
{
	phase += increment;
	lfsr = (lfsr << 1) | (((lfsr >> 31) ^ (lfsr >> 21) ^ (lfsr >> 1) ^ lfsr) & 1);
	counter++;
	clock_count += clocks;
}

static bool crossed(int16_t before, int16_t now, int32_t level, enum scope_edge edge)
{
	bool rising = before < level && now >= level;
	bool falling = before >= level && now < level;

	return (edge == SCOPE_EDGE_RISING && rising) || (edge == SCOPE_EDGE_FALLING && falling) ||
	       (edge == SCOPE_EDGE_EITHER && (rising || falling));
}

int capture_run(const struct scope_config *config, bool force, int16_t *samples,
		struct scope_capture *capture)
{
	double sample_rate = SCOPE_CLOCK_HZ / (config->divider + 1);
	uint32_t increment = (uint32_t)(int64_t)(config->generator_hz / sample_rate * 4294967296.0);
	uint32_t clocks = config->divider + 1;
	uint32_t length = MIN(config->length, SCOPE_WS_MAX_LENGTH);
	uint32_t pre = MIN(length * config->pre_percent / 100, length - 1);
	int64_t now = k_ticks_to_us_floor64(k_uptime_ticks());
	uint64_t passed;
	uint32_t start = 0;
	bool found = false;

	if (sine_table[SINE_POINTS / 4] == 0) {
		make_sine_table();
	}

	/* the samples since the last capture, only the phase and the counters matter */
	passed = (uint64_t)((now - last_uptime_us) * 1e-6 * sample_rate);
	phase += (uint32_t)(passed * increment);
	counter += (uint16_t)passed;
	clock_count += (uint32_t)(passed * clocks);
	last_uptime_us = now;

	for (uint32_t s = 0; s < 2 * length; s++) {
		for (int c = 0; c < SCOPE_CHANNELS; c++) {
			window[s][c] = source_value(config->sources[c]);
		}
		generator_step(increment, clocks);
	}

	if (config->mode != SCOPE_MODE_FREE) {
		uint32_t channel = config->trigger_channel % SCOPE_CHANNELS;

		for (uint32_t s = MAX(pre, 1); s + length - pre <= 2 * length; s++) {
			if (crossed(window[s - 1][channel], window[s][channel],
				    config->trigger_level, config->trigger_edge)) {
				start = s - pre;
				found = true;
				break;
			}
		}
		if (!found && !force) {
			return -EAGAIN;
		}
	}

	memcpy(samples, window[start], length * sizeof(window[0]));
	capture->length = length;
	capture->pre = pre;
	capture->forced = config->mode != SCOPE_MODE_FREE && !found;
	capture->lost = 0;
	return 0;
}

int capture_init(void)
{
	for (int s = 0; s < SCOPE_SOURCES; s++) {
		if (scope_source_names[s] == NULL) {
			scope_source_names[s] = "-";
		}
	}
	return 0;
}

/* no ADCs here */
void capture_set_adc_masks(const uint8_t masks[SCOPE_ADCS])
{
	ARG_UNUSED(masks);
}

void capture_set_adc_settle(const uint32_t settle_ns[SCOPE_ADCS])
{
	ARG_UNUSED(settle_ns);
}

uint32_t capture_adc_conversions(int adc)
{
	ARG_UNUSED(adc);
	return 0;
}

void capture_set_sdm(uint32_t log2, uint32_t phase)
{
	ARG_UNUSED(log2);
	ARG_UNUSED(phase);
}

uint32_t capture_sdm_results(void)
{
	return 0;
}

void capture_set_gate_power(uint32_t enables)
{
	ARG_UNUSED(enables);
}

uint32_t capture_gate_power_on(void)
{
	return 0;
}

void capture_dhb_test(uint32_t periods, uint32_t pulse_clocks, uint32_t ramp_periods,
		      uint32_t run_periods, bool inverted)
{
	ARG_UNUSED(periods);
	ARG_UNUSED(pulse_clocks);
	ARG_UNUSED(ramp_periods);
	ARG_UNUSED(run_periods);
	ARG_UNUSED(inverted);
}

void capture_dhb_stop(void)
{
}

uint32_t capture_dhb_status(void)
{
	return 0;
}

uint32_t capture_dhb_periods(void)
{
	return 0;
}

void capture_set_scaling(int channel, double zero, double per_unit)
{
	ARG_UNUSED(channel);
	ARG_UNUSED(zero);
	ARG_UNUSED(per_unit);
}

void capture_scaler_init(void)
{
}

double capture_scaled(int channel)
{
	ARG_UNUSED(channel);
	return 0.0;
}

void capture_set_dhb_control(bool enable, double kp, double ki, double limit_high, double limit_low)
{
	ARG_UNUSED(enable);
	ARG_UNUSED(kp);
	ARG_UNUSED(ki);
	ARG_UNUSED(limit_high);
	ARG_UNUSED(limit_low);
}

double capture_dhb_command(void)
{
	return 0.0;
}

int capture_dhb_phase(void)
{
	return 0;
}

uint32_t capture_dhb_updates(void)
{
	return 0;
}

uint32_t capture_dhb_run_periods(void)
{
	return 0;
}

void capture_set_dhb_protection(double overcurrent, double overvoltage, uint32_t readings)
{
	ARG_UNUSED(overcurrent);
	ARG_UNUSED(overvoltage);
	ARG_UNUSED(readings);
}

void capture_set_dhb_filter(uint32_t n)
{
	ARG_UNUSED(n);
}

double capture_dhb_filtered(int secondary)
{
	ARG_UNUSED(secondary);
	return 0.0;
}

uint32_t capture_dhb_trips(void)
{
	return 0;
}

double capture_dhb_trip_current(void)
{
	return 0.0;
}

double capture_dhb_trip_voltage(void)
{
	return 0.0;
}

void capture_dhb_clear_trips(void)
{
}

void capture_output_test(double before, double after, uint32_t step_periods, uint32_t periods)
{
	ARG_UNUSED(before);
	ARG_UNUSED(after);
	ARG_UNUSED(step_periods);
	ARG_UNUSED(periods);
}

void capture_output_voltage_test(double before, double after, uint32_t step_periods, uint32_t periods)
{
	ARG_UNUSED(before);
	ARG_UNUSED(after);
	ARG_UNUSED(step_periods);
	ARG_UNUSED(periods);
}

void capture_output_stop(void)
{
}

void capture_output_waveform_prepare(uint32_t periods)
{
	ARG_UNUSED(periods);
}

void capture_dhb_prepare(uint32_t periods, uint32_t pulse_clocks, uint32_t ramp_periods,
			 uint32_t run_periods, bool inverted)
{
	ARG_UNUSED(periods);
	ARG_UNUSED(pulse_clocks);
	ARG_UNUSED(ramp_periods);
	ARG_UNUSED(run_periods);
	ARG_UNUSED(inverted);
}

void capture_sequencer_start(void)
{
}

void capture_sequencer_stop(void)
{
}

void capture_sequencer_power_off(void)
{
}

void capture_sequencer_output_on(void)
{
}

void capture_sequencer_output_off(void)
{
}

uint32_t capture_sequencer_state(void)
{
	return 0;
}

void capture_output_kick(void)
{
}

void capture_lcd_text(uint32_t place, const char *text)
{
	ARG_UNUSED(place);
	ARG_UNUSED(text);
}

void capture_lcd_draw(void)
{
}

uint32_t capture_lcd_cols(void)
{
	return 24;
}

void capture_lcd_button(int button, const uint32_t area[4], uint32_t text_rgb, uint32_t background_rgb)
{
	ARG_UNUSED(button);
	ARG_UNUSED(area);
	ARG_UNUSED(text_rgb);
	ARG_UNUSED(background_rgb);
}

void capture_net_state(struct scope_net_state *state)
{
	memset(state, 0, sizeof(*state));
}

uint32_t capture_fpga_version(void)
{
	return 0;
}

void capture_touch_button(uint32_t x_from, uint32_t x_to, uint32_t y_from, uint32_t y_to)
{
	ARG_UNUSED(x_from);
	ARG_UNUSED(x_to);
	ARG_UNUSED(y_from);
	ARG_UNUSED(y_to);
}

uint32_t capture_touch_presses(void)
{
	return 0;
}

void capture_touch_state(uint32_t state[4])
{
	state[0] = state[1] = state[2] = state[3] = 0;
}

void capture_boost_set(int reg, double value)
{
	ARG_UNUSED(reg);
	ARG_UNUSED(value);
}

double capture_boost_gain(int reg)
{
	ARG_UNUSED(reg);
	return 0.0;
}

void capture_boost_start(void)
{
}

void capture_boost_stop(void)
{
}

void capture_boost_kick(void)
{
}

void capture_boost_state(uint32_t state[2])
{
	state[0] = state[1] = 0;
}

double capture_boost_value(int which)
{
	ARG_UNUSED(which);
	return 0.0;
}

uint32_t capture_waveform_capacity(void)
{
	return 0; /* no waveform player without the board */
}

void capture_waveform_load(const float *volts, const uint32_t *periods, uint32_t count, uint32_t passes)
{
	ARG_UNUSED(volts);
	ARG_UNUSED(periods);
	ARG_UNUSED(count);
	ARG_UNUSED(passes);
}

void capture_output_waveform_test(uint32_t periods)
{
	ARG_UNUSED(periods);
}

uint32_t capture_waveform_status(void)
{
	return 0;
}

uint32_t capture_output_status(void)
{
	return 0;
}

uint32_t capture_output_periods(void)
{
	return 0;
}

void capture_set_observer(bool enable, double l, double c, double r, double current_hz, double voltage_hz)
{
	ARG_UNUSED(enable);
	ARG_UNUSED(l);
	ARG_UNUSED(c);
	ARG_UNUSED(r);
	ARG_UNUSED(current_hz);
	ARG_UNUSED(voltage_hz);
}

double capture_observer(int estimate)
{
	ARG_UNUSED(estimate);
	return 0.0;
}

uint32_t capture_observer_steps(void)
{
	return 0;
}

void capture_set_control(bool enable, double l, double c, double r, double current_hz, double voltage_hz,
			 double b, double voltage_zero, double du_hz, double i_max, double vl_max, double u_max,
			 double prefilter_hz, double feedforward)
{
	ARG_UNUSED(prefilter_hz);
	ARG_UNUSED(feedforward);
	ARG_UNUSED(voltage_zero);
	ARG_UNUSED(enable);
	ARG_UNUSED(l);
	ARG_UNUSED(c);
	ARG_UNUSED(r);
	ARG_UNUSED(current_hz);
	ARG_UNUSED(voltage_hz);
	ARG_UNUSED(b);
	ARG_UNUSED(du_hz);
	ARG_UNUSED(i_max);
	ARG_UNUSED(vl_max);
	ARG_UNUSED(u_max);
}

double capture_control(int value)
{
	ARG_UNUSED(value);
	return 0.0;
}

uint32_t capture_control_flags(void)
{
	return 0;
}

uint32_t capture_control_steps(void)
{
	return 0;
}

void capture_output_control_test(double amplitude, uint32_t half_periods, uint32_t periods)
{
	ARG_UNUSED(amplitude);
	ARG_UNUSED(half_periods);
	ARG_UNUSED(periods);
}
```

## src/panel.c
```c
/*
 * The face panel: its LCD (lcd_display.vhd, a screen of text) and touch screen (touch_reader.vhd).
 *
 * The screen shows the board's address, the last touch, and the commits the firmware and the
 * FPGA image were built from, each on a line of its own; looked at every 200 ms, a line that
 * changed rewritten and the screen redrawn. Under the title the network's state, once a
 * second: the link, the /ws clients and the network watchdog's restarts (main.c).
 *
 * The touch screen's calibration: its controller reads 0..4095 on two axes that need not be the
 * screen's (swapped, mirrored, offset), so screen pixels are an affine map of the raw readings,
 *   px = a rx + b ry + c,  py = d rx + e ry + f
 * fitted (least squares) to four touches on "+" targets near the corners. panel_calibrate()
 * starts it: each target held for half a second, then released; the fit kept in the web client's
 * littlefs (a dot file the file list leaves out, so upload_web.sh keeps it) and read at start.
 * No touch for 30 s gives up and keeps the old calibration.
 *
 * The STOP button: lcd_display draws it (a red rectangle, its area in pixels below) and
 * touch_reader stops the power stage when it is pressed, in the FPGA alone, so it works without
 * this software or the network. Here only its area is given to touch_reader in raw readings,
 * through the calibration (touch_reader's defaults are this board's), and a press is shown.
 *
 * START and OUTPUT, lcd_display's buttons 1 and 2 left of it, are this software's: START from
 * off or stopped starts the supply as a page's Start (the boost to its reference, then the DAB:
 * idle), OUTPUT switches the output on from idle and off when running; each grey when it would
 * do nothing. A press: the touch inside the button (through the calibration: none, no buttons)
 * in two looks 50 ms apart, then a release before the next. A start from the panel keeps the
 * watchdogs kicked until the supply is stopped (scope_panel_command), no page needed. The
 * supply's state and the DC links on row 3.
 */
#include <errno.h>
#include <math.h>
#include <stdio.h>
#include <stdlib.h>
#include <string.h>
#include <zephyr/fs/fs.h>
#include <zephyr/kernel.h>
#include <zephyr/logging/log.h>
#include <zephyr/net/net_if.h>
#include <zephyr/net/net_ip.h>
#include "scope.h"
#include "git_version.h"

LOG_MODULE_REGISTER(panel, LOG_LEVEL_INF);

#define LINE_MAX_COLS 24
#define ROWS          10

#define LINK_ROW     1
#define ADDRESS_ROW  2
#define STATE_ROW    3
#define TOUCH_ROW    4      /* a press's message instead for a while */
#define FIRMWARE_ROW 5
#define FPGA_ROW     6
#define BUTTON_ROW   8      /* the buttons' labels; rows 7 and 9 kept clear under them */
#define LINES        9

/* the STOP button's area, pixels, as lcd_display's defaults */
#define BUTTON_X0 330
#define BUTTON_X1 469
#define BUTTON_Y0 236
#define BUTTON_Y1 309
#define STOP_SHOWN_MS 5000

/* START and OUTPUT (lcd_display's buttons 1 and 2), pixels; their labels' columns on BUTTON_ROW */
static const uint32_t start_area[4] = {10, 159, 236, 309};
static const uint32_t output_area[4] = {170, 319, 236, 309};
#define GREY   0x404040
#define GREEN  0x008000
#define BLUE   0x0050C0
#define ORANGE 0xC06000
#define WHITE  0xFFFFFF

#define CALIBRATION_FILE "/web/.touch_calibration"

/* a "+" in text cell (col, row) is centred on this pixel: the glyph's centre is its column 6,
 * row 8, the font 10 x 16 at twice its size */
#define TARGET_X(col) (20 * (col) + 13)
#define TARGET_Y(row) (32 * (row) + 17)

static const struct {
	uint8_t col, row;
} targets[] = {{1, 1}, {22, 1}, {22, 8}, {1, 8}};

#define TARGETS     ARRAY_SIZE(targets)
#define HOLD_TICKS  10      /* of 50 ms: held this long counts */
#define SETTLE      3       /* the first ticks of a touch left out */
#define LIFTED      4       /* untouched ticks that end a touch (the controller's touch flickers) */
#define GIVE_UP_MS  30000

static struct {
	bool valid;
	double m[6];        /* a b c d e f */
} calibration;

static struct {
	bool active;
	int target;
	int ticks;          /* touched ticks of this target */
	bool captured;      /* held long enough: waiting for the release */
	int untouched;      /* ticks since the touch was last seen */
	double sum_x, sum_y;
	int samples;
	double raw[TARGETS][2];
	int64_t last_touch;
	int64_t message_until;  /* the result shown until then */
} cal;

static char shown[LINES][LINE_MAX_COLS + 1];
static uint32_t presses_seen;
static char message[LINE_MAX_COLS + 1];    /* a press's, shown until message_until */
static int64_t message_until;
static uint32_t button_colours[2] = {~0u, ~0u};     /* as last written: none yet */

/* the touch on the buttons: the one held, its looks, a release awaited */
static struct {
	int button;
	int ticks;
	bool released_awaited;
	int untouched;
} press = {.button = -1};

static void panel_update(struct k_work *work);
static K_WORK_DELAYABLE_DEFINE(panel_work, panel_update);

static uint32_t screen_cols(void)
{
	return MIN(capture_lcd_cols(), LINE_MAX_COLS);
}

/* a row of text padded with spaces to the screen's width */
static void write_row(uint32_t row, const char *text)
{
	char line[LINE_MAX_COLS + 1];
	uint32_t cols = screen_cols();

	snprintf(line, sizeof(line), "%-*.*s", (int)cols, (int)cols, text);
	line[cols] = '\0';
	capture_lcd_text(row * cols, line);
}

static void clear_screen(void)
{
	for (uint32_t row = 0; row < ROWS; row++) {
		write_row(row, "");
	}
	memset(shown, 0, sizeof(shown));    /* every line written again */
}

/* a line of the normal screen, written when it is not what is shown */
static bool normal_line(int which, uint32_t row, const char *text)
{
	char line[LINE_MAX_COLS + 1];
	uint32_t cols = screen_cols();

	snprintf(line, sizeof(line), "%-*s", (int)cols, text);
	line[cols] = '\0';
	if (strcmp(line, shown[which]) == 0) {
		return false;
	}
	capture_lcd_text(row * cols, line);
	memcpy(shown[which], line, sizeof(line));
	return true;
}

bool panel_touch_pixels(const uint32_t touch[4], int *x, int *y)
{
	if (!calibration.valid) {
		return false;
	}
	*x = (int)lround(calibration.m[0] * touch[1] + calibration.m[1] * touch[2] + calibration.m[2]);
	*y = (int)lround(calibration.m[3] * touch[1] + calibration.m[4] * touch[2] + calibration.m[5]);
	return true;
}

/* the STOP button's area in raw readings: its corners through the calibration's inverse, their
 * bounding box (the screen's axes are the controller's swapped: a box either way) */
static void set_button_area(void)
{
	const double *m = calibration.m;
	double det = m[0] * m[4] - m[1] * m[3];
	double low[2] = {4095, 4095}, high[2] = {0, 0};
	const int corners[4][2] = {{BUTTON_X0, BUTTON_Y0}, {BUTTON_X1, BUTTON_Y0},
				   {BUTTON_X1, BUTTON_Y1}, {BUTTON_X0, BUTTON_Y1}};

	if (!calibration.valid || fabs(det) < 1e-12) {
		return;     /* touch_reader's defaults */
	}
	for (int i = 0; i < 4; i++) {
		double px = corners[i][0] - m[2], py = corners[i][1] - m[5];
		double raw[2] = {(m[4] * px - m[1] * py) / det, (m[0] * py - m[3] * px) / det};

		for (int k = 0; k < 2; k++) {
			low[k] = MIN(low[k], raw[k]);
			high[k] = MAX(high[k], raw[k]);
		}
	}
	capture_touch_button((uint32_t)CLAMP(lround(low[0]), 0, 4095), (uint32_t)CLAMP(lround(high[0]), 0, 4095),
			     (uint32_t)CLAMP(lround(low[1]), 0, 4095), (uint32_t)CLAMP(lround(high[1]), 0, 4095));
	LOG_INF("stop button: raw x %.0f..%.0f, y %.0f..%.0f", low[0], high[0], low[1], high[1]);
}

static void show_message(const char *text)
{
	snprintf(message, sizeof(message), "%s", text);
	message_until = k_uptime_get() + STOP_SHOWN_MS;
}

/* START and OUTPUT as the supply's state allows; true when a colour changed */
static bool show_buttons(const char *state, char *labels, size_t size)
{
	bool can_start = strcmp(state, "off") == 0 || strcmp(state, "stopped") == 0;
	bool idle = strcmp(state, "idle") == 0;
	bool running = strcmp(state, "running") == 0;
	uint32_t colours[2] = {can_start ? GREEN : GREY, idle ? BLUE : running ? ORANGE : GREY};
	bool changed = false;

	snprintf(labels, size, "  START  %-7s  STOP", running ? "OUT OFF" : "OUTPUT");
	if (!calibration.valid) {
		return false;   /* no calibration: no buttons but STOP */
	}
	for (int b = 0; b < 2; b++) {
		if (colours[b] != button_colours[b]) {
			capture_lcd_button(b + 1, b == 0 ? start_area : output_area, WHITE, colours[b]);
			button_colours[b] = colours[b];
			changed = true;
		}
	}
	return changed;
}

static void show_normal(void)
{
	uint32_t presses = capture_touch_presses();
	char address[NET_IPV4_ADDR_LEN] = "...";
	char text[LINE_MAX_COLS + 1];
	char labels[LINE_MAX_COLS + 8];
	struct net_in_addr *ip = net_if_ipv4_get_global_addr(net_if_get_default(), NET_ADDR_PREFERRED);
	uint32_t touch[4];
	uint32_t fpga = capture_fpga_version();
	const char *state = scope_supply_state();
	bool changed = false;
	int x, y;

	if (ip != NULL) {
		net_addr_ntop(NET_AF_INET, ip, address, sizeof(address));
	}
	snprintf(text, sizeof(text), "IP %s", address);
	changed |= normal_line(0, ADDRESS_ROW, text);

	/* the supply: its state, the DC links */
	snprintf(text, sizeof(text), "%-8s %5.1f/%5.1f V", state, capture_scaled(SCALER_PRI_VDC_IN),
		 capture_scaled(SCALER_SEC_VDC_OUT));
	changed |= normal_line(5, STATE_ROW, text);

	if (presses != presses_seen) {
		LOG_WRN("stopped by the face panel's STOP button");
		show_message("stopped (panel)");
		presses_seen = presses;
	}
	capture_touch_state(touch);
	if (k_uptime_get() < message_until) {
		snprintf(text, sizeof(text), "%s", message);
	} else if (!touch[0]) {
		snprintf(text, sizeof(text), "touch -");
	} else if (panel_touch_pixels(touch, &x, &y)) {
		snprintf(text, sizeof(text), "touch %d %d", x, y);
	} else {
		snprintf(text, sizeof(text), "touch raw %u %u", touch[1], touch[2]);
	}
	changed |= normal_line(1, TOUCH_ROW, text);

	snprintf(text, sizeof(text), "fw   %s%s", GIT_HASH, GIT_DIRTY ? "+" : "");
	changed |= normal_line(2, FIRMWARE_ROW, text);
	snprintf(text, sizeof(text), "fpga %07x%s", fpga & 0x0fffffff, fpga & BIT(31) ? "+" : "");
	changed |= normal_line(3, FPGA_ROW, text);

	/* the buttons' labels (STOP's in its columns 18..21), the rows above and below clear */
	changed |= show_buttons(state, labels, sizeof(labels));
	changed |= normal_line(4, BUTTON_ROW, labels);
	changed |= normal_line(7, BUTTON_ROW - 1, "");
	changed |= normal_line(8, BUTTON_ROW + 1, "");

	/* the network, once a second */
	static int64_t net_shown;

	if (k_uptime_get() - net_shown >= 1000) {
		struct scope_net_state n;

		net_shown = k_uptime_get();
		capture_net_state(&n);
		snprintf(text, sizeof(text), "link %s %u ws %d r%u", n.link_up ? "up" : "DOWN", n.link_mbps,
			 scope_client_count(), scope_net_resets());
		changed |= normal_line(6, LINK_ROW, text);
	}

	if (changed) {
		capture_lcd_draw();
	}
}

static bool inside(const uint32_t area[4], int x, int y)
{
	return x >= (int)area[0] && x <= (int)area[1] && y >= (int)area[2] && y <= (int)area[3];
}

/* every 50 ms: a press on START or OUTPUT (two looks inside, then a release before the next) */
static void buttons_tick(void)
{
	uint32_t touch[4];
	int x, y, button = -1;
	const char *state;

	capture_touch_state(touch);
	if (touch[0] && panel_touch_pixels(touch, &x, &y)) {
		button = inside(start_area, x, y) ? 0 : inside(output_area, x, y) ? 1 : -1;
	}
	if (press.released_awaited) {
		/* lifted for 200 ms (the controller's touch flickers) */
		press.untouched = touch[0] ? 0 : press.untouched + 1;
		if (press.untouched >= LIFTED) {
			press.released_awaited = false;
		}
		return;
	}
	if (button < 0 || button != press.button) {
		press.button = button;
		press.ticks = button < 0 ? 0 : 1;
		return;
	}
	if (++press.ticks < 2) {
		return;
	}
	press.released_awaited = true;
	press.untouched = 0;
	press.button = -1;
	state = scope_supply_state();
	if (button == 0) {
		if (strcmp(state, "off") == 0 || strcmp(state, "stopped") == 0) {
			scope_panel_command("supply_run");
			show_message("start (panel)");
		}
	} else if (strcmp(state, "idle") == 0) {
		scope_panel_command("output_on");
		show_message("output on (panel)");
	} else if (strcmp(state, "running") == 0) {
		scope_panel_command("output_off");
		show_message("output off (panel)");
	}
}

/* ------------------------------------------------------------------ calibration */

static void show_target(void)
{
	char line[48];      /* write_row cuts it to the screen's width */
	uint32_t cols = screen_cols();

	clear_screen();
	write_row(4, "   touch the + and hold");
	snprintf(line, sizeof(line), "   until it moves (%d/%d)", cal.target + 1, (int)TARGETS);
	write_row(5, line);
	capture_lcd_text(targets[cal.target].row * cols + targets[cal.target].col, "+");
	capture_lcd_draw();
}

/* the 3 x 3 system A v = b by Gaussian elimination with partial pivoting */
static bool solve3(double a[3][3], double b[3], double v[3])
{
	for (int c = 0; c < 3; c++) {
		int p = c;

		for (int r = c + 1; r < 3; r++) {
			if (fabs(a[r][c]) > fabs(a[p][c])) {
				p = r;
			}
		}
		if (fabs(a[p][c]) < 1e-12) {
			return false;
		}
		for (int k = 0; k < 3; k++) {
			double t = a[c][k];

			a[c][k] = a[p][k];
			a[p][k] = t;
		}
		double t = b[c];

		b[c] = b[p];
		b[p] = t;
		for (int r = c + 1; r < 3; r++) {
			double f = a[r][c] / a[c][c];

			for (int k = c; k < 3; k++) {
				a[r][k] -= f * a[c][k];
			}
			b[r] -= f * b[c];
		}
	}
	for (int r = 2; r >= 0; r--) {
		double s = b[r];

		for (int k = r + 1; k < 3; k++) {
			s -= a[r][k] * v[k];
		}
		v[r] = s / a[r][r];
	}
	return true;
}

/* the affine map from the targets' raw readings to their pixels; the fit's rms error, pixels */
static bool fit(double m[6], double *error)
{
	double a[3][3] = {0}, bx[3] = {0}, by[3] = {0};
	double a2[3][3];
	double sum = 0;

	for (size_t i = 0; i < TARGETS; i++) {
		double row[3] = {cal.raw[i][0], cal.raw[i][1], 1.0};

		for (int j = 0; j < 3; j++) {
			for (int k = 0; k < 3; k++) {
				a[j][k] += row[j] * row[k];
			}
			bx[j] += row[j] * TARGET_X(targets[i].col);
			by[j] += row[j] * TARGET_Y(targets[i].row);
		}
	}
	memcpy(a2, a, sizeof(a));
	if (!solve3(a, bx, &m[0]) || !solve3(a2, by, &m[3])) {
		return false;
	}
	for (size_t i = 0; i < TARGETS; i++) {
		double dx = m[0] * cal.raw[i][0] + m[1] * cal.raw[i][1] + m[2] - TARGET_X(targets[i].col);
		double dy = m[3] * cal.raw[i][0] + m[4] * cal.raw[i][1] + m[5] - TARGET_Y(targets[i].row);

		sum += dx * dx + dy * dy;
	}
	*error = sqrt(sum / TARGETS);
	return true;
}

static void save_calibration(void)
{
	struct fs_file_t file;
	char text[200];
	int n = snprintf(text, sizeof(text), "%.9g %.9g %.9g %.9g %.9g %.9g\n", calibration.m[0],
			 calibration.m[1], calibration.m[2], calibration.m[3], calibration.m[4],
			 calibration.m[5]);
	int ret;

	fs_file_t_init(&file);
	ret = fs_open(&file, CALIBRATION_FILE, FS_O_CREATE | FS_O_WRITE | FS_O_TRUNC);
	if (ret == 0) {
		ret = fs_write(&file, text, n) == n ? 0 : -EIO;
		fs_close(&file);
	}
	if (ret != 0) {
		LOG_WRN("touch calibration not kept: %d", ret);
	}
}

static void load_calibration(void)
{
	struct fs_file_t file;
	char text[200];
	char *p = text;
	ssize_t n;

	fs_file_t_init(&file);
	if (fs_open(&file, CALIBRATION_FILE, FS_O_READ) != 0) {
		LOG_INF("touch screen not calibrated");
		return;
	}
	n = fs_read(&file, text, sizeof(text) - 1);
	fs_close(&file);
	if (n <= 0) {
		return;
	}
	text[n] = '\0';
	for (int i = 0; i < 6; i++) {
		char *end;

		calibration.m[i] = strtod(p, &end);
		if (end == p) {
			return;
		}
		p = end;
	}
	calibration.valid = true;
	LOG_INF("touch calibration read");
}

static void finish(const char *message)
{
	cal.active = false;
	clear_screen();
	write_row(4, message);
	capture_lcd_draw();
	cal.message_until = k_uptime_get() + 3000;
}

/* a tick of the calibration: the touch held on the target, then released */
static void calibration_tick(void)
{
	uint32_t touch[4];
	int64_t now = k_uptime_get();

	capture_touch_state(touch);
	if (touch[0]) {
		cal.last_touch = now;
		cal.untouched = 0;
		if (!cal.captured) {
			cal.ticks++;
			if (cal.ticks > SETTLE) {
				cal.sum_x += touch[1];
				cal.sum_y += touch[2];
				cal.samples++;
			}
			if (cal.ticks >= HOLD_TICKS) {
				cal.raw[cal.target][0] = cal.sum_x / cal.samples;
				cal.raw[cal.target][1] = cal.sum_y / cal.samples;
				cal.captured = true;
				LOG_INF("touch target %d: raw %.0f %.0f", cal.target + 1, cal.raw[cal.target][0],
					cal.raw[cal.target][1]);
			}
		}
		return;
	}
	if (++cal.untouched < LIFTED) {
		return;     /* a flicker, or not yet lifted for long */
	}
	if (!cal.captured) {
		/* lifted too early: start this target again */
		cal.ticks = 0;
		cal.samples = 0;
		cal.sum_x = cal.sum_y = 0;
		if (now - cal.last_touch > GIVE_UP_MS) {
			finish("calibration given up");
		}
		return;
	}
	/* released: the next target, or the fit */
	cal.target++;
	cal.ticks = 0;
	cal.samples = 0;
	cal.sum_x = cal.sum_y = 0;
	cal.captured = false;
	cal.untouched = 0;
	if (cal.target < (int)TARGETS) {
		show_target();
		return;
	}

	double m[6], error;
	char line[48];

	if (!fit(m, &error)) {
		finish("calibration failed");
		return;
	}
	memcpy(calibration.m, m, sizeof(m));
	calibration.valid = true;
	save_calibration();
	set_button_area();
	button_colours[0] = button_colours[1] = ~0u;     /* drawn again through the new calibration */
	LOG_WRN("touch calibrated: %.5f %.5f %.1f / %.5f %.5f %.1f, error %.1f px", m[0], m[1], m[2],
		m[3], m[4], m[5], error);
	snprintf(line, sizeof(line), "calibrated: %.1f px", error);
	finish(line);
}

static atomic_t calibrate_requested;

/* from any thread: the calibration starts in the panel's work */
void panel_calibrate(void)
{
	atomic_set(&calibrate_requested, 1);
	k_work_reschedule(&panel_work, K_NO_WAIT);
}

static void start_calibration(void)
{
	memset(&cal, 0, sizeof(cal));
	cal.active = true;
	cal.last_touch = k_uptime_get();
	show_target();
}

bool panel_calibrating(void)
{
	return cal.active;
}

/* ------------------------------------------------------------------ */

static void panel_update(struct k_work *work)
{
	if (atomic_cas(&calibrate_requested, 1, 0)) {
		start_calibration();
	}
	if (cal.active) {
		calibration_tick();
		k_work_reschedule(k_work_delayable_from_work(work), K_MSEC(50));
		return;
	}
	if (cal.message_until != 0) {
		if (k_uptime_get() < cal.message_until) {
			k_work_reschedule(k_work_delayable_from_work(work), K_MSEC(200));
			return;
		}
		cal.message_until = 0;
		clear_screen();
		write_row(0, "ti60 AC PSU");
	}
	/* the buttons looked at every 50 ms, the screen every 200 ms */
	static uint32_t ticks;

	buttons_tick();
	if (ticks++ % 4 == 0) {
		show_normal();
	}
	k_work_reschedule(k_work_delayable_from_work(work), K_MSEC(50));
}

void panel_start(void)
{
	load_calibration();
	set_button_area();
	presses_seen = capture_touch_presses();
	k_work_reschedule(&panel_work, K_NO_WAIT);
}
```
