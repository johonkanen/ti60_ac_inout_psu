## CMakeLists.txt
```
cmake_minimum_required(VERSION 3.20.0)

# board ti60_evm_eth and the TSEMAC/MDIO drivers live in the workspace's module
list(APPEND EXTRA_ZEPHYR_MODULES ${CMAKE_CURRENT_SOURCE_DIR}/../../module)

find_package(Zephyr REQUIRED HINTS $ENV{ZEPHYR_BASE})
project(net_test)

target_sources(app PRIVATE src/main.c)
```

## prj.conf
```kconfig
CONFIG_NETWORKING=y
CONFIG_NET_IPV4=y
CONFIG_NET_IPV6=n
CONFIG_NET_UDP=y
CONFIG_NET_TCP=y
CONFIG_NET_SOCKETS=y
CONFIG_NET_ARP=y
CONFIG_NET_DHCPV4=y

CONFIG_NET_CONFIG_SETTINGS=y
CONFIG_NET_CONFIG_NEED_IPV4=y
CONFIG_NET_CONFIG_INIT_TIMEOUT=0

CONFIG_SHELL=y
CONFIG_NET_SHELL=y
CONFIG_NET_STATISTICS=y
CONFIG_NET_STATISTICS_ETHERNET=y
CONFIG_MDIO_SHELL=y

CONFIG_LOG=y
CONFIG_NET_LOG=y
CONFIG_ETHERNET_LOG_LEVEL_INF=y
CONFIG_PHY_LOG_LEVEL_INF=y
CONFIG_MAIN_STACK_SIZE=4096

CONFIG_NET_L2_ETHERNET=y
# no entropy source in the SoC; fine for bring-up, not for TLS
CONFIG_TEST_RANDOM_GENERATOR=y
```

## boards/ti60_psu_eth.conf
```kconfig
# the board is on a direct link to the PC, no DHCP there; board_test uses 192.168.20.10
CONFIG_NET_DHCPV4=n
CONFIG_NET_CONFIG_MY_IPV4_ADDR="192.168.20.11"
CONFIG_NET_CONFIG_MY_IPV4_NETMASK="255.255.255.0"
```

## src/main.c
```c
/*
 * Ethernet bring-up for the Efinix TSEMAC: gets an IPv4 address with DHCP and
 * answers ping. Use the shell over the console UART: net iface, net arp,
 * net ping, net stats.
 */
#include <zephyr/kernel.h>

int main(void)
{
	printk("net_test on %s\n", CONFIG_BOARD_TARGET);
	return 0;
}
```
